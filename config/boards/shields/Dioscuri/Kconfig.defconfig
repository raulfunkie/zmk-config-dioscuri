## config/boards/shields/Dioscuri/Kconfig.defconfig
```kconfig
if SHIELD_DIOSCURI_LEFT
	
	config ZMK_KEYBOARD_NAME
		default "Dioscuri"
		
	config ZMK_SPLIT_ROLE_CENTRAL
		default y

endif

if SHIELD_DIOSCURI_LEFT || SHIELD_DIOSCURI_RIGHT
	
	config ZMK_SPLIT
		default y
	
endif
```

## config/boards/shields/Dioscuri/Kconfig.shield
```kconfig
config SHIELD_DIOSCURI_LEFT
	def_bool $(shields_list_contains,dioscuri_left)

config SHIELD_DIOSCURI_RIGHT
	def_bool $(shields_list_contains,dioscuri_right)
```
